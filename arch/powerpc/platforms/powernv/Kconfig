## arch/powerpc/platforms/powernv/Kconfig
```kconfig
config PPC_POWERNV
	depends on PPC64 && PPC_BOOK3S
	bool "IBM PowerNV (Non-Virtualized) platform support"
	select PPC_NATIVE
	select PPC_XICS
	select PPC_ICP_NATIVE
	select PPC_XIVE_NATIVE
	select PPC_P7_NAP
	select PCI
	select PCI_MSI
	select EPAPR_BOOT
	select PPC_INDIRECT_PIO
	select PPC_UDBG_16550
	select PPC_SCOM
	select ARCH_RANDOM
	select CPU_FREQ
	select CPU_FREQ_GOV_PERFORMANCE
	select CPU_FREQ_GOV_POWERSAVE
	select CPU_FREQ_GOV_USERSPACE
	select CPU_FREQ_GOV_ONDEMAND
	select CPU_FREQ_GOV_CONSERVATIVE
	select PPC_DOORBELL
	select MMU_NOTIFIER
	select FORCE_SMP
	default y

config OPAL_PRD
	tristate 'OPAL PRD driver'
	depends on PPC_POWERNV
	help
	  This enables the opal-prd driver, a facility to run processor
	  recovery diagnostics on OpenPower machines

config PPC_VAS
	bool "IBM Virtual Accelerator Switchboard (VAS)"
	depends on PPC_POWERNV && PPC_64K_PAGES
	default y
	help
	  This enables support for IBM Virtual Accelerator Switchboard (VAS).

	  VAS allows accelerators in co-processors like NX-GZIP and NX-842
	  to be accessible to kernel subsystems and user processes.

	  VAS adapters are found in POWER9 based systems.

	  If unsure, say N.

config PPC_FTW
	bool "IBM Fast Thread-Wakeup (FTW)"
	depends on PPC_VAS
	default n
	help
	  This enables support for IBM Fast Thread-Wakeup driver.

	  The FTW driver allows applications to utilize a low overhead
	  core-to-core wake up mechansim in the IBM Virtual Accelerator
	  Switchboard (VAS) to improve performance.

	  VAS adapters are found in POWER9 based systems and are required
	  for the FTW driver to be operational.

	  If unsure, say N.
```

## crypto/comp_selftest/Kconfig
```kconfig
config CRYPTO_COMP_SELFTEST
       tristate "Compression Self-Testing module"
       help
         Configurable Compression Self-Testing using debugfs interface.
         This allows you to compress and decompress buffers of variable
         offsets, lengths, and data, using different compressors.  Also
         the average bytes per second rate for compression/decompression
         can be calculated.
```

## drivers/misc/ftw/Kconfig
```kconfig
config PPC_FTW
	tristate "IBM Fast Thread-Wakeup (FTW)"
	depends on PPC_VAS
	default n
	help
          This enables support for IBM Fast Thread-Wakeup driver.

          The FTW driver allows applications to utilize a low overhead
          core-to-core wake up mechansim in the IBM Virtual Accelerator
          Switchboard (VAS) to improve performance.

          VAS adapters are found in POWER9 based systems and are required
          for the FTW driver to be operational.

          If unsure, say N.
```
